## app/Kconfig
```kconfig
menuconfig LED_SUBSYSTEM
	bool "LED Subsystem"
	default y

if LED_SUBSYSTEM

choice
	prompt "LED blink sleep time (1s (medium))"
	default LED_BLINK_SLEEP_1000MS

config LED_BLINK_SLEEP_250MS
	bool "250ms (fast)"

config LED_BLINK_SLEEP_500MS
	bool "500ms (medium fast)"

config LED_BLINK_SLEEP_1000MS
	bool "1s (medium)"

config LED_BLINK_SLEEP_2000MS
	bool "2s (slow)"

endchoice

config LED_BLINK_SLEEP
	int
	default 250 if LED_BLINK_SLEEP_250MS
	default 500 if LED_BLINK_SLEEP_500MS
	default 1000 if LED_BLINK_SLEEP_1000MS
	default 2000 if LED_BLINK_SLEEP_2000MS
	default 0

menuconfig ADVANCED_LED_SETTINGS
	bool "Advanced LED settings"
	default y

if ADVANCED_LED_SETTINGS

config LED_BRIGHTNESS
	int "LED brightness (0-100)"
	range 0 100
	default 100

config LED_FADE_DURATION_MS
	int "Fade duration (ms)"
	range 0 5000
	default 500

menu "Expert settings"
	visible if ADVANCED_LED_SETTINGS

config LED_EXPERT_DEBUG
	bool "Enable LED debugging"
	default n

config LED_EXPERT_CUSTOM_BLINK_PATTERN
	bool "Custom blink pattern"
	default n

endmenu

endif

endif 

source "Kconfig.zephyr"
```

## boards/my_board/board.yml
```yaml
board:
  name: my_board
  full_name: My board
  vendor: iomico
  socs:
  - name: mcxn236
```

## boards/our_board/board.yml
```yaml
board:
  name: our_board
  full_name: Our board
  vendor: iomico
  socs:
  - name: mcxn236
```
